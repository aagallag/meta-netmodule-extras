## conf/layer.conf
```bitbake
# We have a conf and classes directory, add to BBPATH
BBPATH .= ":${LAYERDIR}"

# We have recipes-* directories, add to BBFILES
BBFILES += "${LAYERDIR}/recipes-*/*/*.bb ${LAYERDIR}/recipes-*/*/*.bbappend"

BBFILE_COLLECTIONS += "nm-extas"
BBFILE_PATTERN_nm-extas = "^${LAYERDIR}/"
BBFILE_PRIORITY_nm-extas = "7"

# This should only be incremented on significant changes that will
# cause compatibility issues with other layers
LAYERVERSION_nm-extas = "1"

LAYERDEPENDS_nm-extas = "core"
```
